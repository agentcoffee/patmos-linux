## arch/patmos/Kconfig
```kconfig
# SPDX-License-Identifier: GPL-2.0
#
# For a description of the syntax of this configuration file,
# see Documentation/kbuild/kconfig-language.rst.
#

config PATMOS
	def_bool y
#	select ARCH_32BIT_OFF_T
#	select ARCH_HAS_BINFMT_FLAT
#	select ARCH_HAS_SYNC_DMA_FOR_CPU
#	select ARCH_HAS_SYNC_DMA_FOR_DEVICE
#	select CLKDEV_LOOKUP
#	select HAVE_LEGACY_CLK
#	select GENERIC_ATOMIC64
#	select GENERIC_IRQ_SHOW
#	select HAVE_ARCH_TRACEHOOK
#	select SPARSE_IRQ
#	select IRQ_DOMAIN
#	select OF
#	select OF_EARLY_FLATTREE
#	select GENERIC_CLOCKEVENTS
#	select MODULES_USE_ELF_RELA
#	select MMU_GATHER_NO_RANGE if MMU
#	select SET_FS

config MMU
	def_bool n

config FPU
	def_bool n

config CPU_BIG_ENDIAN
    def_bool y

#config GENERIC_CALIBRATE_DELAY
#	def_bool y
#
#config GENERIC_HWEIGHT
#	def_bool y
#
#config GENERIC_BUG
#	def_bool y
#	depends on BUG

# Use the generic interrupt handling code in kernel/irq/

config CMDLINE_BOOL
	bool "Default bootloader kernel arguments"

config CMDLINE
	string "Kernel command line"
	depends on CMDLINE_BOOL
	default "console=ttyS0,57600"
	help
	  On some architectures there is currently no way for the boot loader
	  to pass arguments to the kernel. For these architectures, you should
	  supply some command-line options at build time by entering them
	  here.

config CMDLINE_FORCE
	bool "Force default kernel command string"
	depends on CMDLINE_BOOL
	default n
	help
	  Set this to have arguments from the default kernel command string
	  override those passed by the boot loader.

menu "Processor type and features"

config KERNEL_RAM_BASE_ADDRESS
	hex "Virtual address of memory base"
	default 0x80000000

source "kernel/Kconfig.hz"

endmenu
```
